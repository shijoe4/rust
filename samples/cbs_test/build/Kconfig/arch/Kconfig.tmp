## samples/cbs_test/build/Kconfig/arch/Kconfig.tmp
```kconfig
# Load Zephyr Arch Kconfig descriptions.
osource "/home/shijo/zephyrproject/zephyr/arch/rx/Kconfig"
osource "/home/shijo/zephyrproject/zephyr/arch/x86/Kconfig"
osource "/home/shijo/zephyrproject/zephyr/arch/xtensa/Kconfig"
osource "/home/shijo/zephyrproject/zephyr/arch/sparc/Kconfig"
osource "/home/shijo/zephyrproject/zephyr/arch/riscv/Kconfig"
osource "/home/shijo/zephyrproject/zephyr/arch/posix/Kconfig"
osource "/home/shijo/zephyrproject/zephyr/arch/mips/Kconfig"
osource "/home/shijo/zephyrproject/zephyr/arch/arm64/Kconfig"
osource "/home/shijo/zephyrproject/zephyr/arch/arm/Kconfig"
osource "/home/shijo/zephyrproject/zephyr/arch/arc/Kconfig"
```

## samples/cbs_test/build/Kconfig/boards/Kconfig.defconfig
```kconfig
# Load Zephyr board defconfig descriptions.
osource "/home/shijo/zephyrproject/zephyr/boards/qemu/riscv32/Kconfig.defconfig"
```

## samples/hello_world/build/Kconfig/boards/Kconfig.qemu_riscv32.tmp
```kconfig
# Load board Kconfig descriptions.
osource "/home/shijo/zephyrproject/zephyr/boards/qemu/riscv32/Kconfig.qemu_riscv32"
```

## samples/hello_world/build/Kconfig/boards/Kconfig.tmp
```kconfig
# Load Zephyr board Kconfig descriptions.
osource "/home/shijo/zephyrproject/zephyr/boards/qemu/riscv32/Kconfig"
```
